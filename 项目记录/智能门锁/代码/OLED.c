#include "OLED.h"
#include "stm32f10x_rcc.h"
#include "stm32f10x_gpio.h"
#include "stm32f10x_i2c.h"

#define OLED_ADDR   0x78      /* OLED器件写地址：7位地址0x3C左移1位，最低位写0 -> 0x78 */

/*==================== I2C硬件初始化 ====================*/
/*
 * 函数：My_I2C_Init
 * 功能：初始化硬件I2C1，PB6=SCL时钟线、PB7=SDA数据线，作为与OLED通信的总线
 */
void My_I2C_Init(void)
{
	GPIO_InitTypeDef GPIO_InitStruct;
	I2C_InitTypeDef I2C_InitStruct;

	RCC_APB2PeriphClockCmd(RCC_APB2Periph_GPIOB,ENABLE);   /* 使能GPIOB端口时钟 */
	RCC_APB1PeriphClockCmd(RCC_APB1Periph_I2C1,ENABLE);    /* 使能I2C1时钟（I2C1挂在APB1总线） */

	/* PB6=SCL, PB7=SDA 配置为复用开漏输出（I2C总线必须开漏，靠上拉电阻拉成高电平） */
	GPIO_InitStruct.GPIO_Pin=GPIO_Pin_6|GPIO_Pin_7;
	GPIO_InitStruct.GPIO_Mode=GPIO_Mode_AF_OD;
	GPIO_InitStruct.GPIO_Speed=GPIO_Speed_50MHz;
	GPIO_Init(GPIOB,&GPIO_InitStruct);
	GPIO_SetBits(GPIOB,GPIO_Pin_6|GPIO_Pin_7);   /* 先把两线置高，保证总线空闲为高电平 */

	I2C_InitStruct.I2C_ClockSpeed=100000;                  /* 总线时钟100kHz标准模式 */
	I2C_InitStruct.I2C_Mode=I2C_Mode_I2C;
	I2C_InitStruct.I2C_AcknowledgedAddress=I2C_AcknowledgedAddress_7bit;  /* 采用7位地址寻址 */
	I2C_InitStruct.I2C_DutyCycle=I2C_DutyCycle_2;
	I2C_InitStruct.I2C_OwnAddress1=0x00;
	I2C_InitStruct.I2C_Ack=I2C_Ack_Enable;                 /* 使能应答ACK */
	I2C_Init(I2C1,&I2C_InitStruct);
	I2C_Cmd(I2C1,ENABLE);                                 /* 使能I2C1外设 */
}

/*==================== I2C发送一帧数据 ====================*/
/*
 * 函数：My_I2C_SendBytes
 * 功能：通过指定I2C外设向从机发送一帧数据（起始->地址->数据->停止）
 * 参数：I2Cx=I2C外设；Addr=从机地址；pData=待发数据缓冲区；Size=发送字节数
 * 返回：0=成功；-1=地址阶段无应答(AF)；-2=数据阶段无应答(AF)
 */
int My_I2C_SendBytes(I2C_TypeDef *I2Cx,uint8_t Addr,uint8_t *pData,uint16_t Size)
{
	uint16_t i;
	while(I2C_GetFlagStatus(I2Cx,I2C_FLAG_BUSY)==SET);  /* 等待总线空闲：BUSY=SET表示忙，循环直到空闲 */
	I2C_GenerateSTART(I2Cx,ENABLE);                     /* 发送起始信号 */
	while(I2C_GetFlagStatus(I2Cx,I2C_FLAG_SB)==RESET);   /* 等待起始标志SB置位 */
	I2C_SendData(I2Cx,Addr&0xfe);                       /* 发送从机地址+写位（最低位清0表示写方向） */
	while(I2C_GetFlagStatus(I2Cx,I2C_FLAG_ADDR)==RESET)  /* 等待地址发送完成ADDR标志 */
	{
		/* 判断：地址阶段收到应答失败AF，发停止信号并返回-1 */
		if(I2C_GetFlagStatus(I2Cx,I2C_FLAG_AF)==SET)
		{ I2C_GenerateSTOP(I2Cx,ENABLE); return -1; }
	}
	(void)I2Cx->SR1; (void)I2Cx->SR2;                   /* 读SR1、SR2以硬件清除ADDR地址标志 */

	/* 循环：逐字节发送Size个数据 */
	for(i=0;i<Size;i++)
	{
		while(I2C_GetFlagStatus(I2Cx,I2C_FLAG_TXE)==RESET)  /* 等待发送缓冲空TXE */
		{
			/* 判断：数据阶段应答失败AF，发停止信号并返回-2 */
			if(I2C_GetFlagStatus(I2Cx,I2C_FLAG_AF)==SET)
			{ I2C_GenerateSTOP(I2Cx,ENABLE); return -2; }
		}
		I2C_SendData(I2Cx,pData[i]);                     /* 发送第i个数据字节 */
	}
	while(I2C_GetFlagStatus(I2Cx,I2C_FLAG_BTF)==RESET);  /* 等待最后一个字节传输完成BTF */
	I2C_GenerateSTOP(I2Cx,ENABLE);                      /* 发送停止信号，结束通信 */
	return 0;                                            /* 成功返回0 */
}

/*==================== OLED写命令/写数据 ====================*/
/* 函数：OLED_Write_Cmd —— 向SSD1306写一条命令；控制字节0x00表示后续是命令 */
static void OLED_Write_Cmd(uint8_t cmd)
{
	uint8_t buf[2];
	buf[0]=0x00;     /* 控制字节0x00：标记接下来发送的是命令字节 */
	buf[1]=cmd;
	My_I2C_SendBytes(I2C1,OLED_ADDR,buf,2);
}
/* 函数：OLED_Write_Data —— 向SSD1306写一个显示数据；控制字节0x40表示后续是显示数据 */
static void OLED_Write_Data(uint8_t dat)
{
	uint8_t buf[2];
	buf[0]=0x40;     /* 控制字节0x40：标记接下来发送的是显示数据字节 */
	buf[1]=dat;
	My_I2C_SendBytes(I2C1,OLED_ADDR,buf,2);
}

/*==================== 8x16 ASCII字模表(0x20空格 ~ 0x5F下划线)，每字符16字节 ====================*/
static const uint8_t F8X16[][16]={

{0x00,0x00,0x00,0x00,0x00,0x00,0x00,0x00,0x00,0x00,0x00,0x00,0x00,0x00,0x00,0x00},/* 锟秸革拷 */

{0x00,0x00,0x00,0xF8,0x00,0x00,0x00,0x00,0x00,0x00,0x00,0xFF,0x00,0x00,0x00,0x00},/* ! */
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{0x00,0x00,0x61,0x51,0x49,0x45,0x43,0x00,0x00,0x00,0x61,0x50,0x48,0x44,0x42,0x00} /* Z */

};


/*
 * 函数：Cursor_Location
 * 功能：设置OLEDGRAM显示光标位置（页地址+列地址）
 * 参数：row=页行；col=列地址(0~127)
 */
void Cursor_Location(uint8_t row,uint8_t col)
{
	uint8_t page = row*2;
	OLED_Write_Cmd(0xB0 + page);                 /* 0xB0+页号：设置GRAM页地址 */
	OLED_Write_Cmd(0x00 + (col & 0x0F));         /* 列地址低4位 */
	OLED_Write_Cmd(0x10 + ((col>>4) & 0x0F));   /* 列地址高4位（列号右移4位） */
}

/*
 * 函数：Show_Char
 * 功能：在指定位置显示一个ASCII字符（取8x16字模的上半8列数据）
 * 参数：a=待显示字符；row=所在页(0~7)；col=起始列(0~127)
 */
void Show_Char(char a,uint8_t row,uint8_t col)
{
	uint8_t i;
	uint8_t ch = a - 0x20;                 /* ASCII偏移：字模表从空格0x20开始，减0x20得到表索引 */
	/* 判断：索引超出字模表范围则回退为空格(0)，防止越界访问 */
	if(ch > (sizeof(F8X16)/16 - 1)) ch = 0;

	OLED_Write_Cmd(0xB0 + row);           /* 定位到目标页 */
	OLED_Write_Cmd(0x00 + (col & 0x0F));  /* 列地址低4位 */
	OLED_Write_Cmd(0x10 + ((col>>4) & 0x0F)); /* 列地址高4位 */
	/* 循环：连续发送该字符的8列点阵数据 */
	for(i=0;i<8;i++) OLED_Write_Data(F8X16[ch][i]);
}

/*
 * 函数：Show_String
 * 功能：从指定位置开始显示一串ASCII字符串，遇到结束符'\0'停止
 * 参数：p=字符串指针；row=所在页；col=起始列
 */
void Show_String(const char *p,uint8_t row,uint8_t col)
{
	/* 循环：指针未到字符串结束符就继续显示下一个字符 */
	while(*p != '\0')
	{
		Show_Char(*p,row,col);             /* 显示当前字符 */
		col += 8;    /* 每个字符占8列，列位置后移8 */
		p++;                               /* 指针移到下一个字符 */
	}
}

/* 函数：OLED_Clear —— 全屏清屏：遍历8个页，每页128列全部写0x00 */
void OLED_Clear(void)
{
	uint8_t page,col;
	/* 外层循环：遍历0~7共8个GRAM页 */
	for(page=0;page<8;page++)
	{
		OLED_Write_Cmd(0xB0+page);         /* 选中当前页 */
		OLED_Write_Cmd(0x00);              /* 列地址低4位=0 */
		OLED_Write_Cmd(0x10);              /* 列地址高4位=0，回到列起点 */
		/* 内层循环：向当前页128列依次写0x00，擦除整页内容 */
		for(col=0;col<128;col++) OLED_Write_Data(0x00);
	}
}

/* 函数：OLED_Init —— SSD1306上电初始化命令序列，配置完成后开启显示并清屏 */
void OLED_Init(void)
{
	My_I2C_Init();
	OLED_Write_Cmd(0xAE);           /* 关闭显示(进入休眠)，先完成配置再开屏 */
	OLED_Write_Cmd(0x20); OLED_Write_Cmd(0x02);  /* 设置寻址模式为页寻址模式 */
	OLED_Write_Cmd(0xB0);
	OLED_Write_Cmd(0xC8);           /* COM扫描方向设置（上下不翻转） */
	OLED_Write_Cmd(0x00);
	OLED_Write_Cmd(0x10);
	OLED_Write_Cmd(0x40);           /* 显示起始行设为0 */
	OLED_Write_Cmd(0x81); OLED_Write_Cmd(0xFF);  /* 设置对比度为最大0xFF */
	OLED_Write_Cmd(0xA1);           /* 段重映射设置（左右镜像） */
	OLED_Write_Cmd(0xA6);           /* 正常显示（非反白黑底） */
	OLED_Write_Cmd(0xA8); OLED_Write_Cmd(0x3F);  /* 多路复用比1/64（64行） */
	OLED_Write_Cmd(0xA4);           /* 输出跟随GRAM内容（非全屏点亮） */
	OLED_Write_Cmd(0xD3); OLED_Write_Cmd(0x00);  /* 显示偏移设为0 */
	OLED_Write_Cmd(0xD5); OLED_Write_Cmd(0x80);  /* 设置时钟分频与振荡频率 */
	OLED_Write_Cmd(0xD9); OLED_Write_Cmd(0xF1);  /* 设置预充电周期 */
	OLED_Write_Cmd(0xDA); OLED_Write_Cmd(0x12);  /* COM引脚硬件配置 */
	OLED_Write_Cmd(0xDB); OLED_Write_Cmd(0x30);  /* 设置VCOMH电压等级 */
	OLED_Write_Cmd(0x8D); OLED_Write_Cmd(0x14);  /* 使能内部电荷泵升压 */
	OLED_Write_Cmd(0xAF);           /* 开启显示 */
	OLED_Clear();                   /* 初始化完成后清屏 */
}
